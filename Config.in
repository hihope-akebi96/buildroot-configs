## board/common/Config.in
```kconfig
# -------------------------------
# SoC definition
# -------------------------------
config BR2_BSP_TARGET_PROC
	string
    default "ld20" if AKEBI96

config BR2_BSP_TARGET_BOARD
	string
    default "ph1-ld20-global-v4" if AKEBI96

config BR2_BSP_TARGET_SERIES
	string
    default "" if AKEBI96

config BR2_BSP_TARGET_ETHPHY
	string
    default "rgmii" if AKEBI96

config BR2_BSP_TARGET_KCONFIG
	string
    default "" if AKEBI96

# -------------------------------
# Target Board definition
# -------------------------------
choice
	prompt "Target Board type"
    default AKEBI96

config AKEBI96
    bool "AKEBI96 board with Android"
    select ANDROID

endchoice

# -------------------------------
# Android Config
# -------------------------------
config ANDROID
    bool
    default n

if ANDROID

choice
    prompt "Select target Android version"
    default ANDROID_900

config ANDROID_900
    bool "Android 9.0.0"

endchoice

endif # ANDROID

# -------------------------------
# System used memory definiton
# -------------------------------
choice
    prompt "Select DDR Memory size for system"
    default USE_MEMORY_SIZE_3GB  if AKEBI96

config USE_MEMORY_SIZE_3GB
    bool "3.0GB"

endchoice
```

## configs/akebi96_defconfig
```kconfig
#-------------------------------------
# for local package build
#-------------------------------------
BR2_PACKAGE_OVERRIDE_FILE="$(BR2_EXTERNAL_BSP_PATH)/../buildroot-local/local.mk"
BR2_DL_DIR="$(BR2_EXTERNAL_BSP_PATH)/../buildroot-local/dl"

#-------------------------------------
# ld20 soc config
#-------------------------------------
BR2_aarch64=y
BR2_cortex_a53=y
BR2_ARM_FPU_VFPV4=y

#-------------------------------------
# Private package setting
#-------------------------------------
BR2_TARGET_UNIPHIER_BL=y
BR2_PACKAGE_ROMUTILS=y
BR2_PACKAGE_MALI_KBASE=y
BR2_PACKAGE_K_MOD_ION_UNPH=y
BR2_PACKAGE_K_MOD_AUDIO=y
BR2_PACKAGE_K_MOD_VIDEO_OUT=y
# BR2_PACKAGE_K_MOD_NET is not set

#-------------------------------------
# Buildroot Common package setting
#-------------------------------------

# ccache
BR2_CCACHE=y
BR2_CCACHE_DIR="$(BR2_EXTERNAL_BSP_PATH)/.ccache"
BR2_CCACHE_INITIAL_SETUP="--max-size 20G"
BR2_CCACHE_USE_BASEDIR=y
BR2_OPTIMIZE_2=y

# toolchain
BR2_TOOLCHAIN_EXTERNAL=y
BR2_TOOLCHAIN_EXTERNAL_CUSTOM=y
BR2_TOOLCHAIN_EXTERNAL_DOWNLOAD=y
BR2_TOOLCHAIN_EXTERNAL_URL="https://releases.linaro.org/components/toolchain/binaries/7.3-2018.05/aarch64-linux-gnu/gcc-linaro-7.3.1-2018.05-x86_64_aarch64-linux-gnu.tar.xz"
BR2_TOOLCHAIN_EXTERNAL_CUSTOM_PREFIX="$(ARCH)-linux-gnu"
BR2_TOOLCHAIN_EXTERNAL_GCC_7=y
BR2_TOOLCHAIN_EXTERNAL_HEADERS_4_10=y
BR2_TOOLCHAIN_EXTERNAL_CUSTOM_GLIBC=y
BR2_TOOLCHAIN_EXTERNAL_CXX=y

# armtf
BR2_TARGET_ARM_TRUSTED_FIRMWARE=y
BR2_TARGET_ARM_TRUSTED_FIRMWARE_CUSTOM_GIT=y
BR2_TARGET_ARM_TRUSTED_FIRMWARE_CUSTOM_REPO_URL="https://git.trustedfirmware.org/TF-A/trusted-firmware-a.git"
BR2_TARGET_ARM_TRUSTED_FIRMWARE_CUSTOM_REPO_VERSION="3c1fb7a7006b2cd076d958aa8ba14eba25e82de8"
BR2_TARGET_ARM_TRUSTED_FIRMWARE_PLATFORM="uniphier"
BR2_TARGET_ARM_TRUSTED_FIRMWARE_UBOOT_AS_BL33=y
BR2_TARGET_ARM_TRUSTED_FIRMWARE_FIP=y

# uboot
BR2_TARGET_UBOOT=y
BR2_TARGET_UBOOT_CUSTOM_GIT=y
BR2_TARGET_UBOOT_CUSTOM_REPO_URL="https://github.com/96boards-akebi96/u-boot.git"
BR2_TARGET_UBOOT_CUSTOM_REPO_VERSION="1f4ae66eaab29bfb5d1eb44996f7826c9cd01ed1"
BR2_TARGET_UBOOT_CUSTOM_DTS_PATH="$(BR2_EXTERNAL_BSP_PATH)/board/akebi96/uboot/dts_ld20-global-v4.dts"
BR2_TARGET_UBOOT_PATCH="$(BR2_EXTERNAL_BSP_PATH)/patches/uboot"
BR2_TARGET_UBOOT_BUILD_SYSTEM_KCONFIG=y
BR2_TARGET_UBOOT_NEEDS_DTC=y
BR2_TARGET_UBOOT_SPL=n
BR2_TARGET_UBOOT_BOARD_DEFCONFIG="uniphier_v8"
BR2_TARGET_UBOOT_FORMAT_BIN=y
BR2_TARGET_UBOOT_CONFIG_FRAGMENT_FILES="$(BR2_EXTERNAL_BSP_PATH)/board/akebi96/uboot/defconfig"

# Linux headers same as kernel, a 4.4 series
BR2_PACKAGE_HOST_LINUX_HEADERS_CUSTOM_4_4=y

BR2_LINUX_KERNEL=y
BR2_LINUX_KERNEL_CUSTOM_GIT=y
BR2_LINUX_KERNEL_CUSTOM_REPO_URL="https://github.com/96boards-akebi96/linux.git"
BR2_LINUX_KERNEL_CUSTOM_REPO_VERSION="e4596b07ef0ee4884d621afa9d5aa5741c8aca7a"
BR2_LINUX_KERNEL_USE_ARCH_DEFAULT_CONFIG=y
BR2_LINUX_KERNEL_CONFIG_FRAGMENT_FILES="$(BR2_EXTERNAL_BSP_PATH)/board/akebi96/linux/v4_4_defconfig"
BR2_LINUX_NEEDS_MODULES=yes
BR2_LINUX_KERNEL_IMAGE_TARGET_CUSTOM=y
BR2_LINUX_KERNEL_IMAGE_TARGET_NAME="Image.gz"

# Build the DTB from the kernel sources
BR2_LINUX_KERNEL_DTS_SUPPORT=y
BR2_LINUX_KERNEL_DTB_IS_SELF_BUILT=y
BR2_LINUX_KERNEL_USE_CUSTOM_DTS=y
BR2_LINUX_KERNEL_CUSTOM_DTS_PATH="$(BR2_EXTERNAL_BSP_PATH)/board/akebi96/linux/akebi96.dts"

# rootfs less
BR2_TARGET_ROOTFS_TAR=n
BR2_INIT_NONE=y
BR2_SYSTEM_BIN_SH_NONE=y
BR2_PACKAGE_BUSYBOX=n
BR2_PACKAGE_HOST_UBOOT_TOOLS=y
BR2_ROOTFS_POST_BUILD_SCRIPT="$(BR2_EXTERNAL_BSP_PATH)/board/akebi96/post_build.sh"
BR2_ROOTFS_POST_IMAGE_SCRIPT="$(BR2_EXTERNAL_BSP_PATH)/board/akebi96/post_image.sh"
```

## package/Config.in
```kconfig
source "$BR2_EXTERNAL_BSP_PATH/package/k_mod_audio/Config.in"
source "$BR2_EXTERNAL_BSP_PATH/package/k_mod_ion_unph/Config.in"
source "$BR2_EXTERNAL_BSP_PATH/package/k_mod_video_out/Config.in"
source "$BR2_EXTERNAL_BSP_PATH/package/k_mod_net/Config.in"
source "$BR2_EXTERNAL_BSP_PATH/package/mali-kbase/Config.in"
source "$BR2_EXTERNAL_BSP_PATH/package/romutils/Config.in"
source "$BR2_EXTERNAL_BSP_PATH/package/k_mod_bt/Config.in"
source "$BR2_EXTERNAL_BSP_PATH/package/k_mod_wifi/Config.in"
```

## package/k_mod_audio/Config.in
```kconfig
config BR2_PACKAGE_K_MOD_AUDIO
    bool "ALSA driver"
    depends on BR2_LINUX_KERNEL
```

## package/k_mod_bt/Config.in
```kconfig
config BR2_PACKAGE_K_MOD_BT
    bool "Bluetooth drivers (from chip-vendor)"
    depends on BR2_LINUX_KERNEL
```

## package/k_mod_ion_unph/Config.in
```kconfig
config BR2_PACKAGE_K_MOD_ION_UNPH
    bool "ION extension driver"
    depends on BR2_LINUX_KERNEL
```

## package/k_mod_isdb/Config.in
```kconfig
config BR2_PACKAGE_K_MOD_ISDB
    bool "ISDB drivers"
    depends on BR2_LINUX_KERNEL
```

## package/k_mod_net/Config.in
```kconfig
config BR2_PACKAGE_K_MOD_NET
    bool "Network drivers (from chip-vendor)"
    depends on BR2_LINUX_KERNEL
```

## package/k_mod_video_out/Config.in
```kconfig
config BR2_PACKAGE_K_MOD_VIDEO_OUT
    bool "Video output kernel driver"
    depends on BR2_LINUX_KERNEL
```

## package/k_mod_wifi/Config.in
```kconfig
config BR2_PACKAGE_K_MOD_WIFI
    bool "WIFI drivers (from chip-vendor)"
    depends on BR2_LINUX_KERNEL
```

## package/mali-kbase/Config.in
```kconfig
config BR2_PACKAGE_MALI_KBASE
    bool "Mali-midgard kernel driver"
    depends on BR2_LINUX_KERNEL
```

## package/romutils/Config.in
```kconfig
config BR2_PACKAGE_ROMUTILS
    bool "ROM utilities"
    select BR2_PACKAGE_HOST_UBOOT_TOOLS
    select BR2_PACKAGE_HOST_UBOOT_TOOLS_FIT_SUPPORT
    select BR2_PACKAGE_HOST_UBOOT_TOOLS_FIT_SIGNATURE_SUPPORT
```
